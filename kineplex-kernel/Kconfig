## kineplex-kernel/Kconfig
```kconfig
config KINEPLEX
config KINEPLEX
	tristate "KinePlex geometry driver"
	depends on X86_64 || ARM64
	depends on IO_URING
	depends on DEBUG_FS
	help
	  Asynchronous fixed-point geometry and geodesic solver for KinePlex.

config KINEPLEX_IO_URING
	bool "KinePlex io_uring command path"
	depends on KINEPLEX
	depends on IO_URING
	default y
	help
	  Expose route submissions through IORING_OP_URING_CMD.

config KINEPLEX_KUNIT_TEST
	tristate "KinePlex KUnit tests"
	depends on KUNIT
	depends on KINEPLEX
	default KUNIT_ALL_TESTS
	help
	  KUnit coverage for KinePlex geometry and safety primitives.
```
